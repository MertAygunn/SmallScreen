#include <Arduino.h>
#include <ESP8266WiFi.h>
#include <ESP8266HTTPClient.h>
#include <WiFiClientSecureBearSSL.h>
#include <Wire.h>
#include <Adafruit_GFX.h>
#include <Adafruit_SSD1306.h>
#include <ArduinoJson.h>
#include <SPI.h>
#include <WiFiUdp.h>
#include <NTPClient.h>

#define DEVICE_NAME "mertDeneme"

#define WIFI_SSID "M52"
#define WIFI_PASS "09101986"

#define SETUP_TIME 4
#define UPDATE_TIME 2

#define SCREEN_WIDTH 128
#define SCREEN_HEIGHT 64
#define OLED_RESET -1
#define SCREEN_ADDRESS 0x3C
Adafruit_SSD1306 display(SCREEN_WIDTH, SCREEN_HEIGHT, &Wire, OLED_RESET);

#define LOGO_GENISLIK 48
#define LOGO_YUKSEKLIK 48

const char* ntpServerName = "tr.pool.ntp.org";
const int timeZone = 3;

WiFiUDP udp;
NTPClient timeClient(udp, ntpServerName, timeZone * 3600, 60000);

const char* apiEndpoint = "https://screenbackend.onrender.com/user?userId=F4:CF:A2:EF:40:E3";

const unsigned char logo_btc[] PROGMEM = {
  0x00, 0x00, 0x0f, 0xf0, 0x00, 0x00, 0x00, 0x00, 0xff, 0xff, 0x00, 0x00, 0x00, 0x03, 0xff, 0xff,
  0xc0, 0x00, 0x00, 0x0f, 0xff, 0xff, 0xf0, 0x00, 0x00, 0x3f, 0xff, 0xff, 0xfc, 0x00, 0x00, 0x7f,
  0xff, 0xff, 0xfe, 0x00, 0x00, 0xff, 0xff, 0xff, 0xff, 0x00, 0x01, 0xff, 0xff, 0xff, 0xff, 0x80,
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  0xff, 0xff, 0xe0, 0x00, 0x00, 0x00, 0xff, 0xff, 0x00, 0x00, 0x00, 0x00, 0x1f, 0xf8, 0x00, 0x00
};
const unsigned char logo_doge[] PROGMEM = {
  0x00, 0x00, 0x00, 0x00, 0x00, 0x00, 0x00, 0x00, 0x00, 0x00, 0x00, 0x00, 0x00, 0x01, 0x80, 0x00,
  0x00, 0x00, 0x00, 0x01, 0x40, 0x00, 0x07, 0x00, 0x00, 0x01, 0xa0, 0x00, 0x0f, 0x00, 0x00, 0x01,
  0x80, 0x00, 0x1f, 0x00, 0x00, 0x01, 0x98, 0x00, 0x3e, 0x00, 0x00, 0x01, 0x80, 0x00, 0x7e, 0x00,
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  0xff, 0xff, 0x80, 0x00, 0x00, 0x00, 0x3f, 0xf0, 0x00, 0x00, 0x00, 0x00, 0x00, 0x00, 0x00, 0x00
};
const unsigned char logo_tether[] PROGMEM = {
  0x00, 0x00, 0x00, 0x00, 0x00, 0x00, 0x00, 0x00, 0x00, 0x00, 0x00, 0x00, 0x00, 0x00, 0x00, 0x00,
  0x00, 0x00, 0x00, 0x00, 0x00, 0x00, 0x00, 0x00, 0x00, 0x00, 0x00, 0x00, 0x00, 0x00, 0x00, 0x00,
  0x07, 0xe0, 0x00, 0x00, 0x00, 0x00, 0x7f, 0xfe, 0x00, 0x00, 0x00, 0x01, 0xff, 0xff, 0x80, 0x00,
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  0x00, 0x00, 0x00, 0x00, 0x00, 0x00, 0x00, 0x00, 0x00, 0x00, 0x00, 0x00, 0x00, 0x00, 0x00, 0x00
};
const unsigned char logo_eth[] PROGMEM = {
  0x00, 0x00, 0x07, 0xf0, 0x00, 0x00, 0x00, 0x00, 0xff, 0xff, 0x00, 0x00, 0x00, 0x03, 0xff, 0xff,
  0xc0, 0x00, 0x00, 0x0f, 0xfe, 0xff, 0xf0, 0x00, 0x00, 0x1f, 0xfc, 0x7f, 0xfc, 0x00, 0x00, 0x7f,
  0xfc, 0x7f, 0xfe, 0x00, 0x00, 0xff, 0xf8, 0x3f, 0xff, 0x00, 0x01, 0xff, 0xf0, 0x1f, 0xff, 0x80,
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  0xff, 0xff, 0xe0, 0x00, 0x00, 0x00, 0xff, 0xff, 0x80, 0x00, 0x00, 0x00, 0x1f, 0xf0, 0x00, 0x00
};
const unsigned char logo_ylv[] PROGMEM = {
  0x00, 0x00, 0x07, 0xf0, 0x00, 0x00, 0x00, 0x00, 0xff, 0xff, 0x00, 0x00, 0x00, 0x03, 0xff, 0xff,
  0xc0, 0x00, 0x00, 0x0f, 0xfe, 0xff, 0xf0, 0x00, 0x00, 0x1f, 0xfc, 0x7f, 0xfc, 0x00, 0x00, 0x7f,
  0xfc, 0x7f, 0xfe, 0x00, 0x00, 0xff, 0xf8, 0x3f, 0xff, 0x00, 0x01, 0xff, 0xf0, 0x1f, 0xff, 0x80,
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  0xff, 0xff, 0xe0, 0x00, 0x00, 0x00, 0xff, 0xff, 0x80, 0x00, 0x00, 0x00, 0x1f, 0xf0, 0x00, 0x00
};

struct asset {
  String symbole;
  const unsigned char* logo;
};

asset assets[] = {
  { "BTC", logo_btc },
  { "DOGE", logo_doge },
  { "USDT", logo_tether },
  { "ETH", logo_eth },
  { "Yalova", logo_ylv }
};

#define OK_GENISLIK 45
#define OK_YUKSEKLIK 26

const unsigned char stonks[] PROGMEM = {
  0x00, 0x00, 0x00, 0x00, 0x07, 0x80, 0x00, 0x00, 0x00, 0x01, 0xff, 0x80, 0x00, 0x00, 0x00, 0x01,
  0xff, 0x80, 0x00, 0x00, 0x00, 0x01, 0xff, 0x80, 0x00, 0x00, 0x00, 0x00, 0xff, 0x80, 0x00, 0x00,
  0x00, 0x00, 0x7f, 0x80, 0x00, 0x00, 0x00, 0x00, 0xff, 0x00, 0x00, 0x00, 0x00, 0x01, 0xef, 0x00,
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  0x00, 0x00, 0x7f, 0xf1, 0xff, 0x80, 0x00, 0x00, 0x7f, 0xf1, 0xff, 0x80
};

const unsigned char notstonks[] PROGMEM = {
  0x0c, 0x00, 0x00, 0x00, 0x00, 0x00, 0x0e, 0x00, 0x00, 0x00, 0x00, 0x00, 0x0f, 0x00, 0x00, 0x00,
  0x00, 0x00, 0x07, 0x80, 0x00, 0x00, 0x00, 0x00, 0x01, 0xc0, 0x00, 0x00, 0x00, 0x00, 0x00, 0xf0,
  0x00, 0x00, 0x00, 0x00, 0x00, 0x78, 0x00, 0xc0, 0x00, 0x00, 0x00, 0x3c, 0x01, 0xe0, 0x00, 0x00,
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  0x0f, 0xfc, 0x7f, 0xf0, 0x00, 0x00, 0x0f, 0xfc, 0x7f, 0xf0, 0x00, 0x00
};

const unsigned char termometre [] PROGMEM = {
  0x00, 0x00, 0x00, 0x00, 0x00, 0x00, 0x00, 0x00, 0x00, 0x01, 0xc0, 0x00, 0x03, 0xe0, 0x00, 0x07, 
  0xf0, 0x00, 0x07, 0xf0, 0x00, 0x07, 0x70, 0x00, 0x06, 0x30, 0x00, 0x06, 0x30, 0x00, 0x06, 0x30, 
  0x00, 0x06, 0x30, 0x00, 0x06, 0x30, 0x00, 0x06, 0x30, 0x00, 0x06, 0x30, 0x00, 0x06, 0x30, 0x00, 
  0x06, 0x30, 0x00, 0x06, 0x30, 0x00, 0x06, 0x30, 0x00, 0x0e, 0x38, 0x00, 0x1c, 0x0c, 0x00, 0x1c, 
  0x0c, 0x00, 0x1c, 0x0c, 0x00, 0x1e, 0x1c, 0x00, 0x0f, 0x38, 0x00, 0x07, 0xf0, 0x00, 0x03, 0xe0, 
  0x00, 0x00, 0x00, 0x00, 0x00, 0x00, 0x00, 0x00, 0x00, 0x00
};

const unsigned char clouds [] PROGMEM = {
  0x00, 0x00, 0x00, 0x00, 0x00, 0x00, 0x00, 0x00, 0x00, 0x00, 0x00, 0x00, 0x00, 0x00, 0x00, 0x01, 
  0xe0, 0x00, 0x07, 0x38, 0x00, 0x04, 0x0f, 0xc0, 0x0c, 0x07, 0xe0, 0x08, 0x04, 0x30, 0x18, 0x00, 
  0x10, 0x38, 0x00, 0x1c, 0x60, 0x00, 0x06, 0xc0, 0x00, 0x03, 0x80, 0x00, 0x01, 0xc0, 0x00, 0x03, 
  0xc0, 0x00, 0x03, 0x70, 0x00, 0x0e, 0x3f, 0xff, 0xfc, 0x00, 0x00, 0x00, 0x00, 0x00, 0x00, 0x00, 
  0x00, 0x00, 0x00, 0x00, 0x00, 0x00, 0x00, 0x00
};

const unsigned char sunny [] PROGMEM = {
  0x00, 0x00, 0x00, 0x00, 0x00, 0x00, 0x00, 0x00, 0x00, 0x00, 0x18, 0x00, 0x00, 0x18, 0x00, 0x06, 
  0x18, 0x60, 0x07, 0x00, 0xe0, 0x03, 0x00, 0xc0, 0x00, 0x7e, 0x00, 0x00, 0xc3, 0x00, 0x00, 0x81, 
  0x00, 0x1c, 0x81, 0x38, 0x1c, 0x81, 0x38, 0x00, 0x81, 0x00, 0x00, 0xc3, 0x00, 0x00, 0x7e, 0x00, 
  0x03, 0x00, 0xc0, 0x07, 0x00, 0xe0, 0x06, 0x18, 0x60, 0x00, 0x18, 0x00, 0x00, 0x18, 0x00, 0x00, 
  0x00, 0x00, 0x00, 0x00, 0x00, 0x00, 0x00, 0x00
};

const unsigned char thunderstorm [] PROGMEM = {
  0x01, 0xf0, 0x00, 0x03, 0xfc, 0x00, 0x06, 0x0c, 0x00, 0x04, 0x07, 0xc0, 0x0c, 0x03, 0xe0, 0x0c, 
  0x00, 0x30, 0x38, 0x00, 0x10, 0x60, 0x00, 0x18, 0xc0, 0x00, 0x1c, 0xc0, 0x18, 0x06, 0xc0, 0x18, 
  0x03, 0xc0, 0x38, 0x03, 0xc0, 0x38, 0x03, 0x60, 0x78, 0x02, 0x3f, 0xdf, 0xfe, 0x0f, 0xcf, 0xf8, 
  0x01, 0x81, 0x80, 0x01, 0xf3, 0x00, 0x01, 0xfa, 0x00, 0x00, 0x1e, 0x00, 0x00, 0x1c, 0x00, 0x00, 
  0x1c, 0x00, 0x00, 0x18, 0x00, 0x00, 0x18, 0x00
};

const unsigned char rain [] PROGMEM = {
  0x01, 0xf0, 0x00, 0x03, 0xfc, 0x00, 0x06, 0x0c, 0x00, 0x04, 0x07, 0xc0, 0x0c, 0x03, 0xe0, 0x0c, 
  0x00, 0x30, 0x38, 0x00, 0x10, 0x60, 0x00, 0x18, 0xc0, 0x00, 0x1c, 0xc0, 0x00, 0x06, 0xc0, 0x00, 
  0x03, 0xc0, 0x00, 0x03, 0xc0, 0x00, 0x03, 0x60, 0x00, 0x02, 0x3f, 0xff, 0xfe, 0x0f, 0xff, 0xf8, 
  0x00, 0x00, 0x00, 0x20, 0x41, 0x82, 0x60, 0xc1, 0x82, 0x60, 0x83, 0x06, 0xcd, 0x93, 0x64, 0x18, 
  0x30, 0x60, 0x18, 0x20, 0xc0, 0x10, 0x20, 0xc0
};

const unsigned char snow [] PROGMEM = {
  0x00, 0x00, 0x00, 0x00, 0x18, 0x00, 0x00, 0x99, 0x00, 0x00, 0x7e, 0x00, 0x04, 0x3c, 0x20, 0x04, 
  0x18, 0x20, 0x36, 0x18, 0x6c, 0x1e, 0x18, 0x78, 0x0e, 0x3c, 0x70, 0x3f, 0xe7, 0xfc, 0x20, 0x81, 
  0x04, 0x00, 0x81, 0x00, 0x00, 0x81, 0x00, 0x20, 0x81, 0x04, 0x3f, 0xe7, 0xfc, 0x0e, 0x3c, 0x70, 
  0x1e, 0x18, 0x78, 0x36, 0x18, 0x6c, 0x04, 0x18, 0x20, 0x04, 0x3c, 0x20, 0x00, 0x7e, 0x00, 0x00, 
  0x99, 0x00, 0x00, 0x18, 0x00, 0x00, 0x00, 0x00
};

const unsigned char drizzle [] PROGMEM = {
  0x00, 0x00, 0x00, 0x00, 0x00, 0x00, 0x00, 0xfe, 0x00, 0x03, 0x87, 0x00, 0x03, 0x01, 0x80, 0x06, 
  0x00, 0xc0, 0x04, 0x00, 0xf8, 0x04, 0x00, 0x1c, 0x1c, 0x00, 0x06, 0x3c, 0x00, 0x03, 0x60, 0x00, 
  0x03, 0xc0, 0x00, 0x03, 0xc0, 0x00, 0x03, 0xc0, 0x00, 0x03, 0xc0, 0x00, 0x06, 0x60, 0x00, 0x0c, 
  0x3f, 0xff, 0xf8, 0x0f, 0xff, 0xe0, 0x00, 0x00, 0x00, 0x0c, 0x63, 0x18, 0x1c, 0xc6, 0x30, 0x18, 
  0x8c, 0x60, 0x00, 0x00, 0x00, 0x00, 0x00, 0x00
};

const unsigned char mist [] PROGMEM = {
  0x00, 0x00, 0x00, 0x00, 0x00, 0x00, 0x00, 0x30, 0x00, 0x01, 0xfe, 0x00, 0x03, 0x83, 0x80, 0x06, 
  0x01, 0x80, 0x0c, 0x00, 0xc0, 0x0c, 0x00, 0x60, 0x08, 0x00, 0x60, 0x18, 0x00, 0x70, 0x78, 0x00, 
  0x38, 0x60, 0x00, 0x0c, 0xc0, 0x00, 0x04, 0x80, 0x00, 0x04, 0x00, 0x00, 0x00, 0xff, 0xff, 0xfc, 
  0x00, 0x00, 0x00, 0x3f, 0xff, 0xff, 0x3f, 0xff, 0xff, 0x00, 0x00, 0x00, 0xff, 0xff, 0xfc, 0xff, 
  0xff, 0xfc, 0x00, 0x00, 0x00, 0x00, 0x00, 0x00
};

const unsigned char smoke [] PROGMEM = {
  0x00, 0x00, 0x00, 0x00, 0x00, 0x00, 0x00, 0x00, 0x00, 0x00, 0x00, 0x00, 0x7f, 0xfe, 0x00, 0xff, 
  0xff, 0x00, 0x00, 0x00, 0x00, 0x00, 0x00, 0x00, 0x03, 0xff, 0xff, 0x00, 0x00, 0x00, 0x00, 0x00, 
  0x00, 0x3f, 0xff, 0xf0, 0x3f, 0xff, 0xf0, 0x00, 0x00, 0x00, 0x00, 0x00, 0x00, 0x07, 0xff, 0xfe, 
  0x00, 0x00, 0x00, 0x00, 0x00, 0x00, 0x3f, 0xfc, 0x00, 0x1f, 0xfc, 0x00, 0x00, 0x00, 0x00, 0x00, 
  0x00, 0x00, 0x00, 0x00, 0x00, 0x00, 0x00, 0x00
};

const unsigned char haze [] PROGMEM = {
  0x00, 0x00, 0x00, 0x00, 0x00, 0x00, 0x00, 0x00, 0x00, 0x00, 0x00, 0x00, 0x7f, 0xfe, 0x00, 0xff, 
  0xff, 0x00, 0x00, 0x00, 0x00, 0x00, 0x00, 0x00, 0x03, 0xff, 0xff, 0x00, 0x00, 0x00, 0x00, 0x00, 
  0x00, 0x3f, 0xff, 0xf0, 0x3f, 0xff, 0xf0, 0x00, 0x00, 0x00, 0x00, 0x00, 0x00, 0x07, 0xff, 0xfe, 
  0x00, 0x00, 0x00, 0x00, 0x00, 0x00, 0x3f, 0xfc, 0x00, 0x1f, 0xfc, 0x00, 0x00, 0x00, 0x00, 0x00, 
  0x00, 0x00, 0x00, 0x00, 0x00, 0x00, 0x00, 0x00
};

const unsigned char dust [] PROGMEM = {
  0x00, 0x00, 0x00, 0x00, 0x00, 0x00, 0x00, 0x00, 0x00, 0x00, 0x00, 0x00, 0x7f, 0xfe, 0x00, 0xff, 
  0xff, 0x00, 0x00, 0x00, 0x00, 0x00, 0x00, 0x00, 0x03, 0xff, 0xff, 0x00, 0x00, 0x00, 0x00, 0x00, 
  0x00, 0x3f, 0xff, 0xf0, 0x3f, 0xff, 0xf0, 0x00, 0x00, 0x00, 0x00, 0x00, 0x00, 0x07, 0xff, 0xfe, 
  0x00, 0x00, 0x00, 0x00, 0x00, 0x00, 0x3f, 0xfc, 0x00, 0x1f, 0xfc, 0x00, 0x00, 0x00, 0x00, 0x00, 
  0x00, 0x00, 0x00, 0x00, 0x00, 0x00, 0x00, 0x00
};

const unsigned char fog [] PROGMEM = {
  0x00, 0x00, 0x00, 0x00, 0x00, 0x00, 0x00, 0x00, 0x00, 0x00, 0x00, 0x00, 0x7f, 0xfe, 0x00, 0xff, 
  0xff, 0x00, 0x00, 0x00, 0x00, 0x00, 0x00, 0x00, 0x03, 0xff, 0xff, 0x00, 0x00, 0x00, 0x00, 0x00, 
  0x00, 0x3f, 0xff, 0xf0, 0x3f, 0xff, 0xf0, 0x00, 0x00, 0x00, 0x00, 0x00, 0x00, 0x07, 0xff, 0xfe, 
  0x00, 0x00, 0x00, 0x00, 0x00, 0x00, 0x3f, 0xfc, 0x00, 0x1f, 0xfc, 0x00, 0x00, 0x00, 0x00, 0x00, 
  0x00, 0x00, 0x00, 0x00, 0x00, 0x00, 0x00, 0x00
};

const unsigned char sand [] PROGMEM = {
  0x00, 0x00, 0x00, 0x00, 0x00, 0x00, 0x00, 0x00, 0x00, 0x00, 0x00, 0x00, 0x7f, 0xfe, 0x00, 0xff, 
  0xff, 0x00, 0x00, 0x00, 0x00, 0x00, 0x00, 0x00, 0x03, 0xff, 0xff, 0x00, 0x00, 0x00, 0x00, 0x00, 
  0x00, 0x3f, 0xff, 0xf0, 0x3f, 0xff, 0xf0, 0x00, 0x00, 0x00, 0x00, 0x00, 0x00, 0x07, 0xff, 0xfe, 
  0x00, 0x00, 0x00, 0x00, 0x00, 0x00, 0x3f, 0xfc, 0x00, 0x1f, 0xfc, 0x00, 0x00, 0x00, 0x00, 0x00, 
  0x00, 0x00, 0x00, 0x00, 0x00, 0x00, 0x00, 0x00
};

const unsigned char ash [] PROGMEM = {
  0x00, 0x00, 0x00, 0x00, 0x00, 0x00, 0x00, 0x00, 0x00, 0x00, 0x00, 0x00, 0x7f, 0xfe, 0x00, 0xff, 
  0xff, 0x00, 0x00, 0x00, 0x00, 0x00, 0x00, 0x00, 0x03, 0xff, 0xff, 0x00, 0x00, 0x00, 0x00, 0x00, 
  0x00, 0x3f, 0xff, 0xf0, 0x3f, 0xff, 0xf0, 0x00, 0x00, 0x00, 0x00, 0x00, 0x00, 0x07, 0xff, 0xfe, 
  0x00, 0x00, 0x00, 0x00, 0x00, 0x00, 0x3f, 0xfc, 0x00, 0x1f, 0xfc, 0x00, 0x00, 0x00, 0x00, 0x00, 
  0x00, 0x00, 0x00, 0x00, 0x00, 0x00, 0x00, 0x00
};

const unsigned char squall [] PROGMEM = {
  0x00, 0x00, 0x00, 0x00, 0x00, 0x00, 0x00, 0x00, 0x00, 0x00, 0x00, 0x00, 0x7f, 0xfe, 0x00, 0xff, 
  0xff, 0x00, 0x00, 0x00, 0x00, 0x00, 0x00, 0x00, 0x03, 0xff, 0xff, 0x00, 0x00, 0x00, 0x00, 0x00, 
  0x00, 0x3f, 0xff, 0xf0, 0x3f, 0xff, 0xf0, 0x00, 0x00, 0x00, 0x00, 0x00, 0x00, 0x07, 0xff, 0xfe, 
  0x00, 0x00, 0x00, 0x00, 0x00, 0x00, 0x3f, 0xfc, 0x00, 0x1f, 0xfc, 0x00, 0x00, 0x00, 0x00, 0x00, 
  0x00, 0x00, 0x00, 0x00, 0x00, 0x00, 0x00, 0x00
};

const unsigned char tornado [] PROGMEM = {
  0x07, 0xff, 0x80, 0x3c, 0x00, 0xf0, 0x60, 0x00, 0x30, 0x7f, 0x87, 0xe0, 0x21, 0xfe, 0x40, 0x30, 
  0x00, 0x40, 0x18, 0x00, 0xc0, 0x0e, 0x01, 0xc0, 0x07, 0xff, 0xc0, 0x73, 0x00, 0x4e, 0xc0, 0xc0, 
  0x63, 0xe0, 0x60, 0x27, 0x3f, 0x23, 0xfc, 0x01, 0x27, 0x20, 0x00, 0x20, 0x20, 0x00, 0x20, 0x60, 
  0x00, 0x60, 0xc0, 0x07, 0x43, 0x98, 0x0e, 0xcc, 0x1c, 0x01, 0xeb, 0xf0, 0x00, 0x50, 0x00, 0x00, 
  0x70, 0x00, 0x00, 0x38, 0x00, 0x00, 0x18, 0x00
};

WiFiClientSecure client;
HTTPClient https;

void logoCizdir(const unsigned char* logo, bool isWeather, String changePercent24Hr) {
  if (isWeather) {
    if (changePercent24Hr == "Clouds") {
      display.drawBitmap(68, 27, clouds, 24, 24, 1);
      display.display();
      Serial.print("Hava durumu logo cizildi");
    } else if (changePercent24Hr == "Snow") {
      display.drawBitmap(68, 27, snow, 24, 24, 1);
      display.display();
      Serial.print("Hava durumu logo cizildi");
    } else if (changePercent24Hr == "Thunderstorm") {
      display.drawBitmap(68, 27, thunderstorm, 24, 24, 1);
      display.display();
      Serial.print("Hava durumu logo cizildi");
    } else if (changePercent24Hr == "Drizzle") {
      display.drawBitmap(68, 27, drizzle, 24, 24, 1);
      display.display();
      Serial.print("Hava durumu logo cizildi");
    } else if (changePercent24Hr == "Rain") {
      display.drawBitmap(68, 27, rain, 24, 24, 1);
      display.display();
      Serial.print("Hava durumu logo cizildi");
    } else if (changePercent24Hr == "Clear") {
      display.drawBitmap(68, 27, sunny, 24, 24, 1);
      display.display();
      Serial.print("Hava durumu logo cizildi");
    } else if (changePercent24Hr == "Mist") {
      display.drawBitmap(68, 27, mist, 24, 24, 1);
      display.display();
      Serial.print("Hava durumu logo cizildi");
    } else if (changePercent24Hr == "Smoke") {
      display.drawBitmap(68, 27, smoke, 24, 24, 1);
      display.display();
      Serial.print("Hava durumu logo cizildi");
    } else if (changePercent24Hr == "Haze") {
      display.drawBitmap(68, 27, haze, 24, 24, 1);
      display.display();
      Serial.print("Hava durumu logo cizildi");
    } else if (changePercent24Hr == "Dust") {
      display.drawBitmap(68, 27, dust, 24, 24, 1);
      display.display();
      Serial.print("Hava durumu logo cizildi");
    } else if (changePercent24Hr == "Fog") {
      display.drawBitmap(68, 27, fog, 24, 24, 1);
      display.display();
      Serial.print("Hava durumu logo cizildi");
    } else if (changePercent24Hr == "Sand") {
      display.drawBitmap(68, 27, sand, 24, 24, 1);
      display.display();
      Serial.print("Hava durumu logo cizildi");
    } else if (changePercent24Hr == "Ash") {
      display.drawBitmap(68, 27, ash, 24, 24, 1);
      display.display();
      Serial.print("Hava durumu logo cizildi");
    } else if (changePercent24Hr == "Squall") {
      display.drawBitmap(68, 27, squall, 24, 24, 1);
      display.display();
      Serial.print("Hava durumu logo cizildi");
    } else if (changePercent24Hr == "Tornado") {
      display.drawBitmap(68, 27, tornado, 24, 24, 1);
      display.display();
      Serial.print("Hava durumu logo cizildi");
    } 
    else {
      display.drawBitmap(0, (display.height() + (display.height() / 4) - LOGO_YUKSEKLIK) / 2, logo, LOGO_GENISLIK, LOGO_YUKSEKLIK, 1);
      display.display();
      Serial.print("Kripto logo cizildi");
  }
}
}

void okCizdir(String changePercent24Hr, bool isWeather) {
  if (isWeather) {
    display.drawLine(0, 15, 127, 15, WHITE);
    display.drawRoundRect(2, 17, 120, 40, 2, WHITE);
    Serial.println("Cizgi ve dikdortgen cizildi");
  } else {
    bool isNumeric = true;
    for (unsigned int i = 0; i < changePercent24Hr.length(); i++) {
      if (!isDigit(changePercent24Hr.charAt(i)) && changePercent24Hr.charAt(i) != '.' && changePercent24Hr.charAt(i) != '-' && changePercent24Hr.charAt(i) != '+') {
        isNumeric = false;
        break;
      }
    }
    if (isNumeric) {
      if (changePercent24Hr.toFloat() >= 0) {
        display.drawBitmap(display.width() - OK_GENISLIK, display.height() - OK_YUKSEKLIK, stonks, OK_GENISLIK, OK_YUKSEKLIK, 1);
        Serial.println("Stonks oku çizildi");
      } else {
        display.drawBitmap(display.width() - OK_GENISLIK, display.height() - OK_YUKSEKLIK, notstonks, OK_GENISLIK, OK_YUKSEKLIK, 1);
        Serial.println("Notstonks oku çizildi");
      }
    }
  }
}

void degerYazdir(String value, bool isWeather) {
  String valueBuf;
  if (isWeather) {
    if (value.length() <= 5) {
      float valueFloat = value.toFloat(); // String'i float'a dönüştür
      int valueInt = (int)valueFloat; // Ondalık kısmı atarak tam sayıya çevir
      String valueBuf = String(valueInt);
      display.setCursor(32, 30); 
      display.setTextSize(2);
      display.print(valueBuf);
      display.drawBitmap(10, 22, termometre, 18, 30, 1);
    } else {
      Serial.println("Hatali sicaklik bilgisi");
    }
  } else {
    valueBuf = value.substring(0, 8) + "$";
      int16_t x1, y1;
      uint16_t w, h;
      display.getTextBounds(valueBuf, 0, 0, &x1, &y1, &w, &h);
      display.setCursor((display.width() - w) / 2, 0);
      display.print(valueBuf);
      Serial.println("Kripto degeri yazildi");
  }
}

void degisimiYazdir(String changePercent24Hr, bool isWeather) {
  if (!isWeather) {
    char changeBuf[10];
    float value = changePercent24Hr.toFloat();
    sprintf(changeBuf, "%.1f%%", value);
    String changeStr = String(changeBuf);
    if (changeStr.length() > 5) {
      changeStr = changeStr.substring(0, 5);
    }
    display.setCursor(LOGO_GENISLIK + 10, display.height() / 4 + 2);
    display.print(changeStr);
    Serial.print("Degisim yazdirildi: ");
    Serial.println(changeStr);
  } else {
    char changeBuf[10];
    float value = changePercent24Hr.toFloat();
    sprintf(changeBuf, "%.1f%%", value);
    String changeStr = String(changeBuf);
    if (changeStr.length() > 5) {
      changeStr = changeStr.substring(0, 5);
    }
    display.setCursor(LOGO_GENISLIK + 10, display.height() / 4 + 2);
    display.print(changeStr);
    Serial.print("Degisim yazdirildi: ");
    Serial.println(changeStr);
  }
}

void isminiYazdir(String symbol, bool isWeather, String saat, String nem) {
  if (isWeather) {
    display.setCursor(42, 20);
    display.print(symbol);
    Serial.println("Sehir ismi yazildi:");
    Serial.print(symbol);
    display.setCursor(32, 0);
    display.setTextSize(2);
    display.print(saat);
    display.setCursor(95, 30);
    display.print(nem); 
  } else {
    display.setCursor(LOGO_GENISLIK + 5, display.height() / 4 * 3);
    display.print(symbol);
    Serial.println("Kripto ismi yazildi:");
    Serial.print(symbol);
  }
}

void setup() {
  Serial.begin(115200);
  WiFi.hostname(DEVICE_NAME);

  if (!display.begin(SSD1306_SWITCHCAPVCC, SCREEN_ADDRESS)) {
    Serial.println(F("HATA: OLED ekran başlatılamadı"));
    while (1);
  }

  timeClient.begin();

  display.clearDisplay();
  display.setTextColor(SSD1306_WHITE);
  display.setTextSize(1);

  for (uint8_t t = SETUP_TIME; t > 0; t--) {
    Serial.printf("[SETUP] Bekleyin %d...\n", t);
    Serial.flush();

    display.clearDisplay();
    display.setCursor(0, display.height() / 4);
    display.print(F("Basliyor bekleyin . . . "));
    display.print(t);
    display.display();
    delay(1000);
  }

  display.setTextSize(2);
  WiFi.mode(WIFI_STA);
  WiFi.begin(WIFI_SSID, WIFI_PASS);

  client.setInsecure(); // Sertifika doğrulamasını devre dışı bırakma
  client.setTimeout(1000); // Zaman aşımı süresini 5 saniye yapma
}

void loop() {
  if (WiFi.status() == WL_CONNECTED) {
    Serial.print("HTTPS başlatılıyor...\n");
    Serial.print("ESP8266 MAC Adresi: ");
    Serial.println(WiFi.macAddress());

      timeClient.update();
      String formattedTime = timeClient.getFormattedTime();
      int lastIndex = formattedTime.lastIndexOf(":");
      String saat = formattedTime.substring(0, lastIndex);

    if (https.begin(client, apiEndpoint)) {
      Serial.print("HTTPS GET...\n");
      int httpCode = https.GET();

      // Sadece yönlendirme durumları için kontrol
      if (httpCode >= 300 && httpCode < 400) {
        String redirectUrl = https.getLocation();
        if (!redirectUrl.startsWith("http")) {
          // If the redirect URL is relative, construct the full URL
          if (redirectUrl.startsWith("/")) {
            redirectUrl = "https://screenbackend.onrender.com" + redirectUrl;
          } else {
            redirectUrl = "https://screenbackend.onrender.com/" + redirectUrl;
          }
        }
        Serial.printf("Redirecting to: %s\n", redirectUrl.c_str());

        https.end();

        if (https.begin(client, redirectUrl)) {
          int redirectHttpCode = https.GET();

          if (redirectHttpCode >= 0) {
            Serial.printf("Redirected HTTPS GET... code: %d\n", redirectHttpCode);

            // JSON verilerini işle
            String payload = https.getString();
            Serial.println("Güncel veriler alındı (redirected)");
            Serial.println(payload); // JSON verilerini yazdır

            DynamicJsonDocument doc(1024);
            deserializeJson(doc, payload);
            bool isWeather = redirectUrl.endsWith("weather");

            for (int i = 0; i < doc.size(); i++) {
              String symbol = doc[i]["name"].as<String>();
              String priceUsd = doc[i]["value"].as<String>();
              String changePercent24Hr = doc[i]["info"].as<String>();
              String nem = doc[i]["humidity"].as<String>();

              Serial.println(isWeather ? "Weather verisi işleniyor" : "Crypto verisi işleniyor");

              bool found = false;
              for (int j = 0; j < sizeof(assets) / sizeof(assets[0]); j++) {
                if (symbol == assets[j].symbole) {
                  Serial.println("Match found!");

                  display.clearDisplay();
                  logoCizdir(assets[j].logo, isWeather, changePercent24Hr);
                  okCizdir(changePercent24Hr, isWeather);
                  degerYazdir(priceUsd, isWeather);
                  if (!isWeather) {
                    degisimiYazdir(changePercent24Hr, isWeather);
                  }
                  display.setTextSize(1);
                  isminiYazdir(symbol, isWeather, saat, nem);
                  display.setTextSize(2);
                  display.display();
                  delay(2000); // Her bir varlık ekranda 2 saniye kalır

                  found = true;
                  break;
                }
              }

              if (!found) {
                Serial.println("Uyumlu veri bulunamadi!");
              }
            }
          } else {
            Serial.printf("Redirected HTTPS GET... error: %s\n", https.errorToString(redirectHttpCode).c_str());
          }
          https.end();
        } else {
          Serial.println("Unable to connect to redirected API");
        }
      } else if (httpCode < 0) {
        Serial.printf("HTTPS GET... error: %s\n", https.errorToString(httpCode).c_str());
      }
      https.end();
    } else {
      Serial.println("Unable to connect to API");
    }
  } else {
    Serial.println("WiFi bağlı değil!");
    delay(1000);
  }
  delay(UPDATE_TIME * 1000); // UPDATE_TIME saniyede bir güncelle
}
